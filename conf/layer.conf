## conf/layer.conf
```bitbake
# We have a conf and classes directory, add to BBPATH
BBPATH .= ":${LAYERDIR}"

# We have recipes-* directories, add to BBFILES
BBFILES += "${LAYERDIR}/recipes-*/*/*.bb \
            ${LAYERDIR}/recipes-*/*/*.bbappend"

BBFILE_COLLECTIONS += "solidrun-am64"
BBFILE_PATTERN_solidrun-am64 = "^${LAYERDIR}/"
BBFILE_PRIORITY_solidrun-am64 = "15"
LAYERVERSION_solidrun-am64 = "1"
LAYERSERIES_COMPAT_solidrun-am64 = "kirkstone"
```

## conf/machine/am64xx-sr-som-k3r5.conf
```bitbake
#@TYPE: Machine
#@NAME: SolidRun AM64 SoM (R5F)
#@SOC: AM64
#@DESCRIPTION: Machine configuration for SolidRun AM64 SoM (R5F core)
#@MAINTAINER: Josua Mayer <josua@solid-run.com>

require conf/machine/include/k3r5.inc

UBOOT_MACHINE = "am64som_r5_defconfig"

SYSFW_SOC = "am64x_sr2"
SYSFW_CONFIG = "sr-som"
SYSFW_SUFFIX = "hs-fs"
```
